## elkscmd/config.in
```kconfig
#
# ELKS Commands configuration menu
#

mainmenu_option next_comment
	comment 'Userland'

	bool 'Select Applications by Image Size'	CONFIG_APPS_BY_IMAGESZ	n
	if [ "$CONFIG_APPS_BY_IMAGESZ" == "n" ]; then

		comment "Shell"

		bool 'ash'        CONFIG_APP_ASH        y
		bool 'sash'       CONFIG_APP_SASH       y

		comment 'Applications'

		busyelks 'diskutils'	CONFIG_APP_DISK_UTILS	y
		busyelks 'fileutils'	CONFIG_APP_FILE_UTILS	y
		busyelks 'shutils'	 	CONFIG_APP_SH_UTILS		y
		bool 'sysutils'			CONFIG_APP_SYS_UTILS	y
		bool 'vi'      			CONFIG_APP_ELVIS		y
		busyelks 'minix1'		CONFIG_APP_MINIX1		y
		bool 'minix2'			CONFIG_APP_MINIX2		y
		busyelks 'minix3'		CONFIG_APP_MINIX3		y
		busyelks 'miscutils'	CONFIG_APP_MISC_UTILS	y
		bool 'Text UI'			CONFIG_APP_TUI  		y
		bool 'nano-X'			CONFIG_APP_NANOX		y
		bool 'BASIC'			CONFIG_APP_BASIC		y
		bool 'screen'     		CONFIG_APP_SCREEN       y
		bool 'cron'           	CONFIG_APP_CRON        	y
		bool 'other'         	CONFIG_APP_OTHER        y
		bool 'test'       		CONFIG_APP_TEST         n
		bool 'busyelks'			CONFIG_APP_BUSYELKS		n
		string 'Additional TAG string for app selection'  CONFIG_APP_TAGS      ''

		#comment 'Commands not compiling'
		#bool 'levee'			CONFIG_APP_LEVEE      n
		#bool 'xvi'        		CONFIG_APP_XVI        n

		if [ "$CONFIG_ARCH_8018X" == "y" ]; then
			comment "8018x tools"
			bool 'romprg'			CONFIG_APP_ROMPRG       n
		fi

		comment "Internet stack and utilities"

		if [ "$CONFIG_INET" == "y" ]; then
			bool 'ktcp' CONFIG_APP_KTCP y
		else
			comment '(ktcp needs TCP/IP sockets)'
		fi

		comment 'Man pages'

		bool 'Man Pages'      		CONFIG_APP_MAN_PAGES  n
	else
		comment "Select Applications by Image Size"

		choice 'Apps and Image Size' \
		"All-2880k/HD	CONFIG_APPS_2880K	\
		 Large-1440k	CONFIG_APPS_1440K	\
		 PC98-1232k     CONFIG_APPS_1232K	\
		 Medium-1200k	CONFIG_APPS_1200K	\
		 Medium-720k	CONFIG_APPS_720K	\
		 Small-360k		CONFIG_APPS_360K" Large-1440k
	fi
	comment "System startup"

	bool 'Use sash as default shell'		CONFIG_SYS_DEFSHELL_SASH n
	bool 'Dont run /bin/init on startup' 	CONFIG_SYS_NO_BININIT n

endmenu
```

## image/config.in
```kconfig
#
# ELKS Image configuration menu
#

mainmenu_option next_comment
	comment 'Target image'

	choice 'Filesystem' \
	"MINIX  CONFIG_IMG_MINIX   \
	 FAT    CONFIG_IMG_FAT     \
	 ROM    CONFIG_IMG_ROM" MINIX

	if [ "$CONFIG_IMG_ROM" != "y" ]; then

		choice 'Medium' \
		"FD2880 CONFIG_IMG_FD2880 \
		 FD1440 CONFIG_IMG_FD1440 \
		 FD1232 CONFIG_IMG_FD1232 \
		 FD1200 CONFIG_IMG_FD1200 \
		 FD720  CONFIG_IMG_FD720  \
		 FD360  CONFIG_IMG_FD360  \
		 HD     CONFIG_IMG_HD" FD1440

		if [ "$CONFIG_IMG_MINIX" == "y" -o "$CONFIG_IMG_ROM" == "y" -o "$CONFIG_IMG_FAT" == "y" ]; then
			define_bool CONFIG_IMG_DEV y
		fi

		if [ "$CONFIG_IMG_HD" == "y" ]; then

			comment 'Disk geometry'
			int 'Sectors'    CONFIG_IMG_SECT  63
			int 'Heads'      CONFIG_IMG_HEAD  16
			int 'Cylinders'  CONFIG_IMG_CYL   63

			comment 'Disk size in 1K blocks'
			int 'Blocks'  CONFIG_IMG_BLOCKS 31752
		fi

		if [ "$CONFIG_IMG_MINIX" == "y" -o "$CONFIG_IMG_FAT" == "y" ]; then
			bool 'Bootable' CONFIG_IMG_BOOT y
		fi
		bool 'Compressed exectuables' CONFIG_APPS_COMPRESS n

		comment 'Binary Images'

		bool 'Build extra binary images' CONFIG_IMG_EXTRA_IMAGES	n

	fi

endmenu
```
