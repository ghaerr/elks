## config.in
```kconfig
#
# ELKS Main
#

mainmenu_name "ELKS Main"

#
# ELKS Kernel
#

mainmenu_option next_comment
	comment 'Kernel & Hardware'
	source elks/config.in

endmenu

#
# ELKS Userland (commands)
#

source elkscmd/config.in

#
# ELKS Images
#

source image/config.in
```

## elks/arch/i86/config.in
```kconfig
#
# See the Configure script for a description of the syntax of this file.
#

mainmenu_name "Linux ELKS Kernel Configuration"
comment 'Just accept the defaults unless you know what you are doing'

mainmenu_option next_comment
    comment 'Advanced - for Developers and Hackers only'

    bool 'Include development code/drivers'	CONFIG_EXPERIMENTAL	n
    bool 'Modular kernel (NOT IMPLEMENTED)'	CONFIG_MODULES		n
endmenu

mainmenu_option next_comment
    comment 'Architecture'

    choice 'Select system architecture'		\
	"Auto		CONFIG_ARCH_AUTO	\
	 IBM-PC 	CONFIG_ARCH_IBMPC	\
	 SIBO		CONFIG_ARCH_SIBO"		Auto

    if [ "$CONFIG_ARCH_SIBO" != "y" ]; then
	choice 'Select PC system architecture'	\
	    "Auto	CONFIG_PC_AUTO		\
	     PC/XT	CONFIG_PC_XT		\
	     PC/AT	CONFIG_PC_AT		\
	     MCA	CONFIG_PC_MCA"			Auto

	bool 'Build kernel as ROM-bootable'		CONFIG_ROMCODE	n
    else
	define_bool CONFIG_ROMCODE n
    fi

    bool 'Minimize kernel size'			CONFIG_SMALL_KERNEL	n
endmenu

if [ "$CONFIG_ARCH_IBMPC" = "y" ]; then
    mainmenu_option next_comment
	comment 'Model-specific features'

	choice 'Model of computer'		\
	    "TrueClone	CONFIG_IBMPC_CLONE	\
	     Compaq	CONFIG_IBMPC_COMPAQ"		TrueClone
	if [ "$CONFIG_IBMPC_COMPAQ" = "y" ]; then
	    bool 'Switch Compaq DeskPro to fast mode'	CONFIG_COMPAQ_FAST  n
	fi
	bool 'Mount root partition read-only by default' CONFIG_ROOT_READONLY n
    endmenu
fi

mainmenu_option next_comment
    comment 'Memory manager'
  	
    bool 'Advanced memory manager'			CONFIG_ADVANCED_MM	y
	
    if [ "$CONFIG_ADVANCED_MM" = "y" ]; then
	     bool 'Enable swap support'			CONFIG_SWAP	n
	fi

endmenu

mainmenu_option next_comment
    comment 'Hardware Facilities'

    if [ "$CONFIG_ARCH_IBMPC" = "y" ]; then
	choice 'Processor'			\
	    "8086	CONFIG_CPU_8086		\
	     80186	CONFIG_CPU_80186	\
	     80286	CONFIG_CPU_80286	\
	     80386	CONFIG_CPU_80386	\
	     80486+	CONFIG_CPU_80486"		8086
    fi
    if [ "$CONFIG_ARCH_IBMPC" = "y" ]; then
	mainmenu_option next_comment
	    comment 'System Hardware'

	    bool 'System has a math coprocessor'	CONFIG_HW_FPU        y
	    bool 'System has a PS/2 pointing device'	CONFIG_HW_PS2_MOUSE  y
	    bool 'System has a VGA adapter'		CONFIG_HW_VGA        y
	endmenu
    fi

    if [ "$CONFIG_ARCH_SIBO" != "y" ]; then
	mainmenu_option next_comment
	    comment 'Block Devices'

	    bool 'System has a floppy drive'	CONFIG_HW_FLOPPY_DRIVE   y
	    bool 'System has a hard drive'	CONFIG_HW_HARD_DRIVE     y
	endmenu
    fi

#    if [ "$CONFIG_ARCH_IBMPC" = "y" ]; then
#	mainmenu_option next_comment
#	    comment 'Character Devices'
#
#	    int 'Number of valid text consoles' CONFIG_CONSOLES_MAX 3 3 15
#	endmenu
#    fi

    if [ "$CONFIG_ARCH_IBMPC" = "y" ]; then
	mainmenu_option next_comment
	    comment 'Memory Configuration'

	    int 'Base memory size (64K pages)'  	CONFIG_MEM_PAGES  8 4 10
	    if [[ "$CONFIG_CPU_8086" != "y" && "$CONFIG_CPU_80186" != "y" ]]; then
		bool 'Extended (XMS) memory support'	CONFIG_XMS	  n
		if [ "$CONFIG_XMS" = "y" ]; then
		    bool '  Use interrupt 15 for XMS size'	CONFIG_XMS_INT15  n
		    if [ "$CONFIG_XMS_INT15" != "y" ]; then
			int '  Extended memory size in kB'	CONFIG_XMS_SIZE   0
		    else
			define_int CONFIG_XMS_SIZE 0
		    fi
		else
		    define_bool CONFIG_XMS_INT15 n
		    define_int  CONFIG_XMS_SIZE  0
		fi
	    else
		define_bool CONFIG_XMS_INT15 n
		define_int  CONFIG_XMS_SIZE  0
	    fi
	endmenu
    fi

    if [ "$CONFIG_ARCH_IBMPC" = "y" ]; then
	mainmenu_option next_comment
	    comment 'BIOS Facilities'

	    bool 'System has keyboard BIOS support'		CONFIG_HW_KEYBOARD_BIOS y
	    bool 'Get fontinfo via CRT-BIOS (40h:85h)'		CONFIG_HW_VIDEO_HOC y
	    if [ "$CONFIG_HW_VIDEO_HOC" != "y" ]; then
		int 'Height of characters in lines'		CONFIG_HW_VIDEO_LINES_PER_CHARACTER 8
		int 'Lines per page'				CONFIG_HW_VIDEO_LINES_PER_SCREEN 25
	    fi

	    bool 'Use bootup IRQ-Mask of 8259 as default'	CONFIG_HW_259_USE_ORIGINAL_MASK n
	    int 'Ticks for BogoMIPS (0 = check at boottime)'	CONFIG_BOGOMIPS 0
	    bool 'Use int 13 for floppy count'			CONFIG_HW_USE_INT13_FOR_FLOPPY n
	    bool 'Use int 13 for disk parameters'		CONFIG_HW_USE_INT13_FOR_DISKPARMS y
	    bool 'Advanced Power Management support'		CONFIG_APM y
	endmenu
    fi
endmenu

if [ "$CONFIG_ROMCODE" = "y" ]; then
    mainmenu_option next_comment
	comment 'ROM-CODE kernel-loader'

	comment 'Absolute segment locations for code in target system EPROM'
	hex 'Setup code (0x60 ROM)'	CONFIG_ROM_SETUP_CODE	0xe000
	hex 'Kernel code (64k ROM)'	CONFIG_ROM_KERNEL_CODE	0xe060
	comment ''
	comment 'Absolute segment locations for data in target system RAM'
	hex 'Setup data (0x20 RAM)'	CONFIG_ROM_SETUP_DATA	0x0060
	hex 'IRQ Scheduler (0x10 RAM)'	CONFIG_ROM_IRQ_DATA	0x0080
	hex 'Kernel data (64k RAM)'	CONFIG_ROM_KERNEL_DATA	0x0090

	comment 'Information for ROM-Image generator'
	hex 'Start address of ROM (for offset in image-file)'	CONFIG_ROM_BASE 0xe000
	int 'Area with BIOS Checksum in kbytes (normally 64)'	CONFIG_ROM_CHECKSUM_SIZE 64
	bool 'Make image-file bootable by reset' 		CONFIG_ROM_BOOTABLE_BY_RESET n
	if [ "$CONFIG_ROM_BOOTABLE_BY_RESET" = "y" ]; then
	    hex 'Address jumped after reset (offset in image)'	CONFIG_ROM_RESET_ADDRESS 0x0003
	    bool 'Add startup module to image (BIOS-functions)'	CONFIG_ROM_ADD_BIOS_IMAGE n
	    if [ "$CONFIG_ROM_ADD_BIOS_IMAGE" = "y" ]; then
		string 'Name of module' 			CONFIG_ROM_BIOS_MODULE "bios/bioscode.bin"
		hex 'Module code segment address'		CONFIG_ROM_BIOS_MODULE_ADDR 0xf000
	    fi
	fi
	comment 'Generate debug code and information'
	bool 'ROM-CODE debug information'			CONFIG_ROM_DEBUG
    endmenu

    mainmenu_option next_comment
	comment 'EPROM Simulator'

	bool 'Use EPROM Simulator after make'			CONFIG_ROM_USE_SIMULATOR n
	if [ "$CONFIG_ROM_USE_SIMULATOR" = "y" ]; then
	    string 'Program call'				CONFIG_ROM_SIMULATOR_PROGRAM "/usr/bin/simu -t18 Image"
	fi
    endmenu
fi

if [ "$CONFIG_EXPERIMENTAL" = "y" ]; then
    mainmenu_option next_comment
	comment '286 Protected Mode Support'

	bool '286 protected mode support'	CONFIG_286PMODE 	n
	if [ "$CONFIG_286PMODE" = "y" ]; then
	    bool 'Support 16M+ on 386+' 	CONFIG_386RAM		n
	fi
    endmenu
fi

mainmenu_option next_comment
    comment 'Driver Support'

    source arch/i86/drivers/block/Config.in
    source arch/i86/drivers/char/Config.in
    source fs/Config.in
    source net/Config.in
endmenu

mainmenu_option next_comment
    comment 'Kernel hacking'

    bool 'Include kernel version system call'	CONFIG_SYS_VERSION	n
    bool 'System Trace' 			CONFIG_STRACE		n
endmenu
```

## elks/arch/i86/drivers/block/config.in
```kconfig
#
# Block device driver configuration
#
mainmenu_option next_comment
    comment 'Block device drivers'

	bool '  BIOS floppy drive support'	CONFIG_BLK_DEV_BFD	y
	bool '  Direct hw floppy support'	CONFIG_BLK_DEV_FD	n
	bool '  Floppy drive track caching'	CONFIG_TRACK_CACHE	y
	bool '  BIOS preset floppy types'	CONFIG_BLK_DEV_BFD_HARD n
	bool '  BIOS hard drive support'	CONFIG_BLK_DEV_BHD	y
	bool '  IDE hard drive CHS probe'	CONFIG_IDE_PROBE	y
	if [ "$CONFIG_BLK_DEV_FD" == "y" ]; then
		define_bool CONFIG_ASYNCIO y
	fi

	comment 'Additional block devices'

	bool 'RAM disk support'			CONFIG_BLK_DEV_RAM	y
	if [ "$CONFIG_BLK_DEV_RAM" == "y" ]; then
		hex 'Preload RAM disk segment address' CONFIG_RAMDISK_SEGMENT 0
		int 'Preload RAM disk sectors' CONFIG_RAMDISK_SECTORS 128
	fi
	choice 'SSD disk driver' \
		"None CONFIG_BLK_DEV_SSD_NONE \
		Test CONFIG_BLK_DEV_SSD_TEST \
		SDCard CONFIG_BLK_DEV_SSD_SD" None

	if [ "$CONFIG_BLK_DEV_SSD_SD" == "y" ] && [ "$CONFIG_ARCH_NECV25" == "y" ]; then
      bool 'Interface SD card with hardware SPI'	CONFIG_HW_SPI	y
	fi

	bool 'ATA-CF drive support'	        CONFIG_BLK_DEV_ATA_CF	n

	if [ "$CONFIG_ARCH_IBMPC" == "y" ]; then
		bool 'XT MFM hard drive support' CONFIG_BLK_DEV_MFMHD n
	else
		define_bool CONFIG_BLK_DEV_MFMHD n
	fi
	if [ "$CONFIG_BLK_DEV_MFMHD" == "y" ]; then
		hex '  Primary MFM I/O port' CONFIG_MFMHD_PRIMARY_PORT 0x320
		hex '  Secondary MFM I/O port' CONFIG_MFMHD_SECONDARY_PORT 0x324
		int '  MFM drives to probe' CONFIG_MFMHD_ACTIVE_DRIVES 1
		choice '  MFM controller profile' \
			"WD1002A-WX1 CONFIG_MFMHD_CTRL_WD1002 \
			Seagate-ST11-FileCard CONFIG_MFMHD_CTRL_SEAGATE" WD1002A-WX1
		if [ "$CONFIG_MFMHD_CTRL_WD1002" == "y" ]; then
			choice '  WD1002A-WX1 BIOS geometry table' \
				"Super CONFIG_MFMHD_BIOS_SUPER \
				G CONFIG_MFMHD_BIOS_G \
				H CONFIG_MFMHD_BIOS_H" Super
		fi
		int '  Command step-rate code' CONFIG_MFMHD_STEP_CODE 0
		bool '  Slow timing profile by default' CONFIG_MFMHD_SLOW n
		int '  Drive 0 cylinders override (0 uses controller)' CONFIG_MFMHD_DRIVE0_CYLINDERS 0
		int '  Drive 0 heads override (0 uses controller)' CONFIG_MFMHD_DRIVE0_HEADS 0
		int '  Drive 0 sectors override (0 uses controller)' CONFIG_MFMHD_DRIVE0_SECTORS 0
		int '  Drive 1 cylinders override (0 uses controller)' CONFIG_MFMHD_DRIVE1_CYLINDERS 0
		int '  Drive 1 heads override (0 uses controller)' CONFIG_MFMHD_DRIVE1_HEADS 0
		int '  Drive 1 sectors override (0 uses controller)' CONFIG_MFMHD_DRIVE1_SECTORS 0
		int '  Drive 2 cylinders override (0 uses controller)' CONFIG_MFMHD_DRIVE2_CYLINDERS 0
		int '  Drive 2 heads override (0 uses controller)' CONFIG_MFMHD_DRIVE2_HEADS 0
		int '  Drive 2 sectors override (0 uses controller)' CONFIG_MFMHD_DRIVE2_SECTORS 0
		int '  Drive 3 cylinders override (0 uses controller)' CONFIG_MFMHD_DRIVE3_CYLINDERS 0
		int '  Drive 3 heads override (0 uses controller)' CONFIG_MFMHD_DRIVE3_HEADS 0
		int '  Drive 3 sectors override (0 uses controller)' CONFIG_MFMHD_DRIVE3_SECTORS 0
		bool '  Maintenance ioctls (diagnostic/format/control)' CONFIG_MFMHD_DIAG_IOCTLS n
		bool '  Trace MFM command handshakes' CONFIG_MFMHD_TRACE n
	fi

    comment 'Block device options'
    bool 'Character access to block devices'	CONFIG_BLK_DEV_CHAR	y
endmenu
```

## elks/arch/i86/drivers/char/Config.in
```kconfig
#
# Character device driver configuration
#

mainmenu_option next_comment
    comment 'Character device drivers'

    if [ "$CONFIG_ARCH_SIBO" != "y" ]; then
	choice 'Select console driver'			\
		"Direct         CONFIG_CONSOLE_DIRECT	\
		 BIOS           CONFIG_CONSOLE_BIOS	\
		 Serial         CONFIG_CONSOLE_SERIAL"		Direct
	if [[ "$CONFIG_CONSOLE_DIRECT" = "y" || "$CONFIG_CONSOLE_BIOS" = "y" ]]; then
	    choice 'Console terminal emulation'			\
		    "ANSI           CONFIG_EMUL_ANSI	\
		     VT52           CONFIG_EMUL_VT52	\
		     None           CONFIG_EMUL_NONE"		ANSI
	    if [ "$CONFIG_EMUL_ANSI" = "y" ]; then
		bool 'ANSI Colourized printk'	CONFIG_EMUL_ANSI_PRINTK n
	    fi
	fi
	if [ "$CONFIG_CONSOLE_DIRECT" = "y" ]; then
	    source arch/i86/drivers/char/KeyMaps/Config.in
	fi
    else
	choice 'Select console driver'			\
		"Direct     CONFIG_SIBO_CONSOLE_DIRECT	\
		 Serial     CONFIG_CONSOLE_SERIAL"	Direct
	if [ "$CONFIG_SIBO_CONSOLE_DIRECT" = "y" ]; then
	    bool '  Support virtual consoles'	CONFIG_SIBO_VIRTUAL_CONSOLE  n
	    bool '  Direct console serial echo'	CONFIG_SIBO_CONSOLE_ECHO     n
	    define_bool CONFIG_SIBO_DEFAULT_KEYMAP y
	fi
    fi

    comment 'Other character devices'
    if [ "$CONFIG_ARCH_SIBO" != "y" ]; then
	if [ "$CONFIG_CONSOLE_SERIAL" = "n" ]; then
	    bool 'Serial device driver'		CONFIG_CHAR_DEV_RS	  y
	else
	    define_bool CONFIG_CHAR_DEV_RS y
	fi
	bool 'Parallel device driver'		CONFIG_CHAR_DEV_LP	  y
    fi
    bool 'Memory character devices'		CONFIG_CHAR_DEV_MEM	  y
    bool 'Pseudo tty device driver'		CONFIG_PSEUDO_TTY	  y
    if [ "$CONFIG_EXPERIMENTAL" = "y" ]; then
	bool 'Meta device driver'		CONFIG_DEV_META		  n
    fi
endmenu
```

## elks/config.in
```kconfig
# Kernel configuration

comment 'Just accept the defaults unless you know what you are doing'

mainmenu_option next_comment
	comment 'System'

	choice 'Select system' \
		"IBM-PC CONFIG_ARCH_IBMPC \
		 8018X	CONFIG_ARCH_8018X \
		 PC-98	CONFIG_ARCH_PC98" IBM-PC

	comment 'Platform'

	if [ "$CONFIG_ARCH_IBMPC" = "y" ]; then

		bool 'Compaq DeskPro Hardware (fast mode)' CONFIG_HW_COMPAQFAST n
		bool 'MK-88 Hardware (IRQ 3 keyboard)' CONFIG_HW_MK88 n

		comment 'Devices'

		bool 'VGA adapter'      CONFIG_HW_VGA       y
		bool 'Serial port FIFO' CONFIG_HW_SERIAL_FIFO y

	elif [ "$CONFIG_ARCH_8018X" = "y" ]; then

		comment 'Devices'
		hex 'RTC (AT compatible) I/O address' CONFIG_8018X_RTC 0x200

		comment 'INTx pins (0=disabled)'
		int 'INT0 Logical IRQ' CONFIG_8018X_INT0 0
		int 'INT1 Logical IRQ' CONFIG_8018X_INT1 12
		int 'INT0 Logical IRQ' CONFIG_8018X_INT2 0
		int 'INT0 Logical IRQ' CONFIG_8018X_INT3 0
		int 'INT0 Logical IRQ' CONFIG_8018X_INT4 0

		define_bool CONFIG_CONSOLE_DIRECT   n
		define_bool CONFIG_CONSOLE_8018X    y

	elif [ "$CONFIG_ARCH_PC98" = "y" ]; then

		comment 'Devices'

	fi

endmenu

mainmenu_option next_comment
	comment 'Kernel settings'

	bool 'Boot options in /bootopts'          CONFIG_BOOTOPTS     y
	bool 'Use Async I/O in kernel'            CONFIG_ASYNCIO      n
	bool 'Calculate process CPU usage'        CONFIG_CPU_USAGE    y
	bool 'Real time clock in localtime'       CONFIG_TIME_RTC_LOCALTIME n
	string 'Compiled-in TZ= timezone string'  CONFIG_TIME_TZ      ''
	bool 'System tracing (set on for development)' CONFIG_TRACE   n
	bool 'Use INT 0Fh in idle loop for timer' CONFIG_TIMER_INT0F  n
	bool 'Use INT 1Ch from BIOS for timer'    CONFIG_TIMER_INT1C  n

	if [ "$CONFIG_ARCH_IBMPC" = "y" ] || [ "$CONFIG_ARCH_8018X" = "y" ]; then
		bool 'Build kernel as ROM-bootable'   CONFIG_ROMCODE      n
    fi

    bool 'Far text kernel'	                CONFIG_FARTEXT_KERNEL y

endmenu

if [ "$CONFIG_ROMCODE" = "y" ]; then
    mainmenu_option next_comment
	comment 'ROM-CODE kernel-loader'

	comment 'Absolute segment locations for code in target system ROM'
	hex 'Setup code (0x60 ROM)'	CONFIG_ROM_SETUP_CODE	0xe000
	hex 'Kernel code (64k ROM)'	CONFIG_ROM_KERNEL_CODE	0xe060

	comment 'Absolute segment locations for data in target system RAM'
	hex 'Setup data (0x20 RAM)'	CONFIG_ROM_SETUP_DATA	0x0060
	hex 'Kernel data (64k RAM)'	CONFIG_ROM_KERNEL_DATA	0x0080

	comment 'Information for ROM-Image generator'
	hex 'Start address of ROM (for offset in image-file)'	CONFIG_ROM_BASE 0xe000
	int 'Area with BIOS Checksum in kbytes (normally 64)'	CONFIG_ROM_CHECKSUM_SIZE 64
	bool 'Make image-file bootable by reset' 		CONFIG_ROM_BOOTABLE_BY_RESET n
	if [ "$CONFIG_ROM_BOOTABLE_BY_RESET" = "y" ]; then
	    hex 'Address jumped after reset (offset in image)'	CONFIG_ROM_RESET_ADDRESS 0x0003
	    bool 'Add startup module to image (BIOS-functions)'	CONFIG_ROM_ADD_BIOS_IMAGE n
	    if [ "$CONFIG_ROM_ADD_BIOS_IMAGE" = "y" ]; then
		string 'Name of module' 			CONFIG_ROM_BIOS_MODULE "bios/bioscode.bin"
		hex 'Module code segment address'		CONFIG_ROM_BIOS_MODULE_ADDR 0xf000
	    fi
	fi
	comment 'Generate debug code and information'
	bool 'ROM-CODE debug information'			CONFIG_ROM_DEBUG
    endmenu

    mainmenu_option next_comment
	comment 'EPROM Simulator'

	bool 'Use EPROM Simulator after make'			CONFIG_ROM_USE_SIMULATOR n
	if [ "$CONFIG_ROM_USE_SIMULATOR" = "y" ]; then
	    string 'Program call'				CONFIG_ROM_SIMULATOR_PROGRAM "/usr/bin/simu -t18 Image"
	fi
    endmenu
fi

# Networking support

source elks/net/config.in

# Filesystem support

source elks/fs/config.in

# Drivers configuration

mainmenu_option next_comment
	comment 'Drivers'

	source elks/arch/i86/drivers/block/config.in
	source elks/arch/i86/drivers/char/config.in
	source elks/arch/i86/drivers/net/config.in

endmenu
```
