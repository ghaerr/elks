## elks/arch/i86/drivers/char/config.in
```kconfig
#
# Character device driver configuration
#

mainmenu_option next_comment
	comment 'Character device drivers'

	choice 'Select console driver'			\
		"Direct         CONFIG_CONSOLE_DIRECT	\
		 BIOS           CONFIG_CONSOLE_BIOS	\
		 Amstrad	CONFIG_CONSOLE_AMSTRAD_IGA 	\
		 8018x		CONFIG_CONSOLE_8018X 	\
		 NECV25		CONFIG_CONSOLE_NECV25 	\
		 Headless       CONFIG_CONSOLE_HEADLESS"	Direct
	if [ "$CONFIG_CONSOLE_DIRECT" = "y" ]; then
		if [ "$CONFIG_ARCH_SWAN" = "y" ]; then
			choice 'Console font'			\
				"8x8   CONFIG_CONSOLE_FONT_8X8  \
				4x8    CONFIG_CONSOLE_FONT_4X8" 4x8
		fi
		bool '  Scancode keyboard driver'	CONFIG_KEYBOARD_SCANCODE y
		bool '  Dual-screen console support'    CONFIG_CONSOLE_DUAL n
	fi
	if [ "$CONFIG_CONSOLE_AMSTRAD_IGA" = "y" ]; then
		define CONFIG_KEYBOARD_SCANCODE y
		define CONFIG_CONSOLE_DUAL n
	fi
	bool 'Serial Console'	CONFIG_CONSOLE_SERIAL		n
	if [[ "$CONFIG_CONSOLE_DIRECT" = "y" || "$CONFIG_CONSOLE_BIOS" = "y" \
	   || "$CONFIG_CONSOLE_AMSTRAD_IGA" = "y" ]]; then
		int  '  Number of virtual consoles (1-8)' CONFIG_CONSOLE_MAX 3
	        bool 'Console ANSI terminal emulation'  CONFIG_EMUL_ANSI  y
	fi
	if [[ "$CONFIG_CONSOLE_DIRECT" = "y" \
	   || "$CONFIG_CONSOLE_AMSTRAD_IGA" = "y" ]]; then
		source elks/arch/i86/drivers/char/KeyMaps/config.in
	fi

	comment 'Other character devices'
	if [ "$CONFIG_CONSOLE_SERIAL" = "n" ]; then
		bool 'Serial device driver'	CONFIG_CHAR_DEV_RS	  y
	else
		define_bool CONFIG_CHAR_DEV_RS y
	fi
	bool 'Parallel device driver'		CONFIG_CHAR_DEV_LP	  y
	#bool 'CGA text mode videobuffer'	CONFIG_CHAR_DEV_CGATEXT	  n
	bool 'Memory character devices'		CONFIG_CHAR_DEV_MEM	  y
	if [ "$CONFIG_CHAR_DEV_MEM" = "y" ]; then
		bool '  /dev/port read'	 CONFIG_CHAR_DEV_MEM_PORT_READ	n
		bool '  /dev/port write' CONFIG_CHAR_DEV_MEM_PORT_WRITE	n
	fi

	bool 'Pseudo tty device driver'		CONFIG_PSEUDO_TTY	  y

	if [ "$CONFIG_ARCH_IBMPC" = "y" ]; then
		bool 'Sound Blaster /dev/dsp driver'	CONFIG_CHAR_DEV_DSP	  n
	else
		define_bool CONFIG_CHAR_DEV_DSP n
	fi
	# Native AD1848 (Windows Sound System) driver.  Alternative to the Sound
	# Blaster driver, not an addition: both claim /dev/dsp, and on an 82C929
	# the SB personality and the codec window are alternative routings of the
	# same part selected by MC1 bit 7.
	if [ "$CONFIG_CHAR_DEV_DSP" = "n" ]; then
		bool 'AD1848/WSS /dev/dsp driver (OPTi 82C929 native)' CONFIG_CHAR_DEV_DSP_AD1848 n
	else
		define_bool CONFIG_CHAR_DEV_DSP_AD1848 n
	fi
	if [ "$CONFIG_CHAR_DEV_DSP_AD1848" = "y" ]; then
		hex  '  WSS I/O base'		CONFIG_AD1848_WSS_BASE	0x530
		int  '  WSS IRQ (7, 9, 10 or 11)' CONFIG_AD1848_IRQ	7
		int  '  WSS DMA channel'	CONFIG_AD1848_DMA	1
		int  '  Playback buffer bytes'	CONFIG_SB_BOUNCE	4096
	fi
	if [ "$CONFIG_CHAR_DEV_DSP" = "y" ]; then
		define_bool CONFIG_AUDIO_SB y
		define_bool CONFIG_AUDIO_MAD y
	fi
endmenu
```
